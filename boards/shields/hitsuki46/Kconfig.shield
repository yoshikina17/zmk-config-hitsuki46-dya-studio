## boards/shields/hitsuki46/Kconfig.shield
```kconfig
config SHIELD_HITSUKI46_R
    def_bool $(shields_list_contains,hitsuki46_R)

config SHIELD_HITSUKI46_L
    def_bool $(shields_list_contains,hitsuki46_L)
```
